## boards/shields/nice-view-jade44/Kconfig.defconfig
```kconfig
if SHIELD_NICE_VIEW_JADE44

config LV_Z_VDB_SIZE
    default 100

config LV_DPI_DEF
    default 161

config LV_Z_BITS_PER_PIXEL
    default 1

choice LV_COLOR_DEPTH
    default LV_COLOR_DEPTH_1
endchoice

choice ZMK_DISPLAY_WORK_QUEUE
    default ZMK_DISPLAY_WORK_QUEUE_DEDICATED
endchoice

choice ZMK_DISPLAY_STATUS_SCREEN
    default ZMK_DISPLAY_STATUS_SCREEN_CUSTOM
endchoice

config LV_Z_MEM_POOL_SIZE
    default 8192 if ZMK_DISPLAY_STATUS_SCREEN_CUSTOM

config ZMK_DISPLAY_STATUS_SCREEN_CUSTOM
    imply NICE_VIEW_WIDGET_STATUS

config NICE_VIEW_JADE44_BT_1
    string "Name of first bluetooth profile."
    default "Work"

config NICE_VIEW_JADE44_BT_2
    string "Name of second bluetooth profile."
    default "Phone"

config NICE_VIEW_JADE44_BT_3
    string "Name of third bluetooth profile."
    default "Home"

config NICE_VIEW_JADE44_BT_4
    string "Name of fourth bluetooth profile."
    default "iPad"

config NICE_VIEW_JADE44_BT_5
    string "Name of fifth bluetooth profile."
    default "EMPTY"

endif # SHIELD_NICE_VIEW_JADE44
```

## boards/shields/nice-view-jade44/boards/shields/nice_view_jade44/Kconfig.shield
```kconfig
config SHIELD_NICE_VIEW_JADE44
    def_bool $(shields_list_contains,nice_view_jade44)
```
